## drivers/soc/samsung/Kconfig
```kconfig
#
# EXYNOS Soc drivers
#
menuconfig SOC_SAMSUNG
	bool "SAMSUNG SOC drivers support"

if SOC_SAMSUNG
config EXYNOS_CHIPID
	bool "Exynos Chip ID Driver Support"
	depends on ARCH_EXYNOS
	select SOC_BUS

config EXYNOS_REBOOT
	bool "Exynos Chip Reboot Driver Support"
	depends on ARCH_EXYNOS

config SAMSUNG_DMADEV
	bool
	select ARM_AMBA
	select DMADEVICES
	select PL330_DMA if (ARCH_EXYNOS8 || ARCH_EXYNOS3)
	help
	  Use DMA device engine for PL330 DMAC.

config ECT
	bool "Enable Exynos Characteristic Table File"
	default n
	depends on ARCH_EXYNOS

config ECT_DUMP
	bool "Enable Exynos Characteristic Table File Dump sysfs"
	default n
	depends on ECT

config EXYNOS_HOTPLUG_GOVERNOR
	bool "Enable Exynos dynamic hotplug governor"

config EXYNOS_PM_DVS
	bool "Enable Exynos dynamic voltage setting"
	default n

config EXYNOS_OTP
	bool "Exynos OTP (one-time programmable) support"
	default n
	depends on ARCH_EXYNOS
	help
		This option enables OTP (one-time programmable) tune bits functions

config EXYNOS_PSMW_CPU_HOTPLUG
	bool "On demand polling of CPU Hotplug"
	depends on ARCH_EXYNOS
	default n
	help
	 This is an aggressive power saving feature for dynamic cpu hotplug.
	 Normally, the check routine for cpu dynamic hotplug occurs periodically.
	 However, if you enable this feature, the check routine won't occur
	 until display is updated.

config EXYNOS_ASV
	bool "ASV support for Exynos"
	default y
	help
		Support to provide ABB and ASV voltage values.

config ASV_MARGIN_TEST
	bool "Enable margin test"
	depends on EXYNOS_ASV
	default n
	help
		Support to ASV voltage margin test

config EXYNOS_PSMW
	bool "Power Saving Manager for Wearable"
	help
	  This provides aggressive power saving features for wearable devices

config EXYNOS_PSMW_CPU_HOTPLUG
	bool "On demand polling of CPU Hotplug"
	depends on EXYNOS_PSMW
	help
	  This is an aggressive power saving feature for dynamic cpu hotplug.
	  Normally, the check routine for cpu dynamic hotplug occurs periodically.
	  However, if you enable this feature, the check routine won't occur
	  until display is updated.

config EXYNOS_PSMW_DVFS
	bool "On demand polling of DVFS"
	depends on EXYNOS_PSMW
	help
	  This is an aggressive power saving feature for DVFS.
	  Normally, the check routine for DVFS occurs periodically.
	  However, if you enable this feature, the check routine won't occur
	  until display is updated.

config EXYNOS_PSMW_WORKQUEUE
	bool "On demand polling of Workqueue"
	depends on EXYNOS_PSMW
	help
	  This is an aggressive power saving feature for some workqueues.

config EXYNOS_PSMW_MEM
	bool "Dynamic DRAM policy"
	depends on EXYNOS_PSMW
	help
	  This is an aggressive power saving feature for the system memory.
	  Especially, LPDDR DRAM has some policies and modes that could be adaptively applied.

config EXYNOS_PSMW_DEBUG
	bool "Enable PSMW debug message"
	depends on EXYNOS_PSMW
	default n

choice
	prompt "Type of Periodic work"
	default DELAYED_INVOKING
	help
	  This option sets which type of workqueue shall be used for periodic execution.

config EXYNOS_PSMW_DELAYED_INVOKING
	bool "Use delayed workqueue"
	help
	  Use the INIT_DELAYED_WORK()

config EXYNOS_PSMW_DEFERRABLE_INVOKING
	bool "Use deferrable workqueue"
	help
	  Use the INIT_DEFERRABLE_WORK()
endchoice


endif #SOC_SAMSUNG
```

## drivers/trace/Kconfig
```kconfig
#
# Trace(debugging) driver configuration
#

menuconfig TRACE
	bool "TRACE driver support"
	default y
	help
	  The "TRACE driver" is a kind of driver for debugging

if TRACE

menuconfig EXYNOS_SNAPSHOT
	bool "Exynos SnapShot(ESS) support for debugging"
	default y
	depends on ARCH_EXYNOS

config EXYNOS_SNAPSHOT_CALLSTACK
	int "shown callstack level"
	depends on EXYNOS_SNAPSHOT
	range 1 4
	default 4

config EXYNOS_SNAPSHOT_IRQ_EXIT
	bool "Enable debugging of interrupt exit event by kevent"
	depends on EXYNOS_SNAPSHOT && !EXYNOS_SNAPSHOT_MINIMIZED_MODE
	default y

config EXYNOS_SNAPSHOT_IRQ_EXIT_THRESHOLD
	int "threshold of detection(microsecond)"
	depends on EXYNOS_SNAPSHOT_IRQ_EXIT && !EXYNOS_SNAPSHOT_MINIMIZED_MODE
	range 0 1000000
	default 0

config EXYNOS_SNAPSHOT_IRQ_DISABLED
	bool "Enable debugging of interrupt disable event by kevent(EXPERIMENTAL)"
	depends on EXYNOS_SNAPSHOT && !EXYNOS_SNAPSHOT_MINIMIZED_MODE
	default n

config EXYNOS_SNAPSHOT_SPINLOCK
	bool "Enable debugging of spinlock event by kevent(EXPERIMENTAL)"
	depends on EXYNOS_SNAPSHOT && DEBUG_SPINLOCK && !EXYNOS_SNAPSHOT_MINIMIZED_MODE
	default y

config EXYNOS_SNAPSHOT_CLK
	bool "Enable debugging of clock event by kevent(EXPERIMENTAL)"
	depends on EXYNOS_SNAPSHOT && !EXYNOS_SNAPSHOT_MINIMIZED_MODE
	default y

config EXYNOS_SNAPSHOT_FREQ
	bool "Enable debugging of frequence event by kevent(EXPERIMENTAL)"
	depends on EXYNOS_SNAPSHOT && PM_DEVFREQ && !EXYNOS_SNAPSHOT_MINIMIZED_MODE
	default y

config EXYNOS_SNAPSHOT_HRTIMER
	bool "Enable debugging of hrtimer by kevent"
	depends on EXYNOS_SNAPSHOT && !EXYNOS_SNAPSHOT_MINIMIZED_MODE
	default n

config EXYNOS_SNAPSHOT_SOFTIRQ
	bool "Enable debugging of softirq by kevent"
	depends on EXYNOS_SNAPSHOT && !EXYNOS_SNAPSHOT_MINIMIZED_MODE
	default y

config EXYNOS_SNAPSHOT_REG
	bool "Enable debugging of accessing register by kevent"
	depends on EXYNOS_SNAPSHOT && !EXYNOS_SNAPSHOT_MINIMIZED_MODE
	default n

config EXYNOS_SNAPSHOT_REGULATOR
	bool "Enable debugging of regulator and pmic driver"
	depends on EXYNOS_SNAPSHOT && !EXYNOS_SNAPSHOT_MINIMIZED_MODE
	default y

config EXYNOS_SNAPSHOT_MBOX
	bool "Enable debugging of mailbox for transferring with APM"
	depends on EXYNOS_SNAPSHOT && EXYNOS_MBOX && !EXYNOS_SNAPSHOT_MINIMIZED_MODE
	default y

config EXYNOS_SNAPSHOT_HOOK_LOGGER
	bool "Enable hooking android platform log for ramdump"
	depends on EXYNOS_SNAPSHOT
	default y

config EXYNOS_SNAPSHOT_PSTORE
	bool "Enable supporting pstore fs for logging and hooking"
	depends on EXYNOS_SNAPSHOT_HOOK_LOGGER
	select PSTORE
	select PSTORE_RAM
	select PSTORE_PMSG
	default y

config EXYNOS_SNAPSHOT_PANIC_REBOOT
	bool "Enable forced reboot after panic for ramdump"
	depends on EXYNOS_SNAPSHOT
	default y

config EXYNOS_SNAPSHOT_WATCHDOG_RESET
	bool "Support watchdog reset when hardlockup detect"
	depends on EXYNOS_SNAPSHOT && EXYNOS_SNAPSHOT_PANIC_REBOOT
	default y

config EXYNOS_SNAPSHOT_MINIMIZED_MODE
	bool "Support minimized feature configuration"
	depends on EXYNOS_SNAPSHOT
	default n

endif
#
```

## drivers/video/fbdev/exynos/decon_7570/panels/Kconfig
```kconfig
config EXYNOS_DECON_LCD
	depends on EXYNOS_DECON_7570
	bool "Select LCD panel driver"

config EXYNOS_DECON_LCD_S6E8AA0
	depends on EXYNOS_DECON_LCD && EXYNOS_MIPI_DSI
	tristate "S6E8AA0 AMOLED HD LCD driver(720 x 1280)"

config EXYNOS_DECON_LCD_S6E8AA5X01
	depends on EXYNOS_DECON_LCD && EXYNOS_MIPI_DSI
	tristate "S6E8AA5X01 AMOLED HD LCD driver(720 x 1280)"

config EXYNOS_DECON_LCD_S6E36W1X01
	depends on EXYNOS_DECON_LCD && EXYNOS_MIPI_DSI
	tristate "S6E36W1X01 AMOLED HD LCD driver(360 x 360)"

config EXYNOS_DECON_LCD_S6E3AA2
	depends on EXYNOS_DECON_LCD && EXYNOS_MIPI_DSI
	tristate "S6E3AA2 AMOLED HD LCD driver(720 x 1280)"

config EXYNOS_DECON_LCD_RM69080
        depends on EXYNOS_DECON_LCD && EXYNOS_MIPI_DSI
        tristate "RM69080 AMOLED HD LCD driver(400 x 400)"

config EXYNOS_DECON_LCD_AUO_H120BLN017
	depends on EXYNOS_DECON_LCD && EXYNOS_MIPI_DSI
	tristate "AUO_H120BLN017 AMOLED LCD driver(390 x 390)"

config EXYNOS_DECON_LCD_SHARP_LCD
	depends on EXYNOS_DECON_LCD && EXYNOS_MIPI_DSI
	tristate "SHARP LCD driver(320 x 300)"

config BACKLIGHT_SUBCPU
	depends on EXYNOS_DECON_LCD_SHARP_LCD
	tristate "Notify backlight brightness to SubCpu"
```
